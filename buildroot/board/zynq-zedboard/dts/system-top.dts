/*
 * CAUTION: This file is automatically generated by Xilinx.
 * Version: XSCT 2022.2
 * Today is: Fri Feb 21 14:48:08 2025
 */


/dts-v1/;
#include "zynq-7000.dtsi"
#include "zedboard.dtsi"
#include "pl.dtsi"
#include "pcw.dtsi"
#include "system-user.dtsi"
/ {
	chosen {
		bootargs = "earlycon";
		stdout-path = "serial0:115200n8";
	};
	aliases {
		ethernet0 = &gem0;
		serial0 = &uart1;
		spi0 = &qspi;
	};
	memory {
		device_type = "memory";
		reg = <0x0 0x20000000>;
	};
};
